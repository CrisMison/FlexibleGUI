## kconfig
```kconfig
# All configure should be in directory "build/kconfig"

# Architecuture and build setting, include the cross-complie setting, prefix, etc.

menu "Architecuture & Build Setting"
source "build/kconfig/kconfig_arch"
endmenu

menu "Driver Setting"
source "build/kconfig/kconfig_driver"
endmenu


menu "Tools & Debug Setting"
source "build/kconfig/kconfig_tools"
endmenu
```
